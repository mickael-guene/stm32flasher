## .travis/buildroot/defconfig
```kconfig
BR2_TOOLCHAIN_EXTERNAL=y
BR2_INIT_NONE=y
# BR2_TARGET_ENABLE_ROOT_LOGIN is not set
# BR2_TARGET_GENERIC_GETTY is not set
# BR2_TARGET_GENERIC_REMOUNT_ROOTFS_RW is not set
# BR2_PACKAGE_BUSYBOX is not set
BR2_PACKAGE_OPENOCD=y
BR2_PACKAGE_OPENOCD_STLINK=y
BR2_PACKAGE_COREUTILS=y
BR2_TARGET_ROOTFS_TAR_XZ=y
```
